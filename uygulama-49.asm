	LIST P=16F877A
	#INCLUDE <P16F877A.INC>
	SAYICI1 EQU 0X20
	SAYICI2 EQU 0X21
	SICAKLIK_REF EQU 0X22
	ORG 0X000
	GOTO ANA_METOT

ANA_METOT
	BANKSEL TRISA
	MOVLW 0XFF
	MOVWF TRISA
	CLRF TRISB
	CLRF TRISC
	CLRF TRISD

	MOVLW B'10000000'
	MOVWF ADCON1
	
	BANKSEL PORTA
	MOVLW 0XFF
	MOVWF PORTA
	CLRF PORTB
	CLRF PORTC
	CLRF PORTD

	BANKSEL ADCON0
	MOVLW B'11000001'
	MOVWF ADCON0
	CALL GECIKME
	BANKSEL ADCON0

	BANKSEL SICAKLIK_REF
	MOVLW D'31'
	MOVWF SICAKLIK_REF

DONUSTUR_METOT
	BSF ADCON0,GO
	CALL GECIKME
	CALL YAZDIR
	BANKSEL PORTD
	BTFSC PORTD,0
	CALL ARTIR
	BTFSC PORTD,1
	CALL AZALT
	GOTO DONUSTUR_METOT

ARTIR
	BANKSEL SICAKLIK_REF
	MOVLW H'02'
	ADDWF SICAKLIK_REF,F
	CALL GECIKME
	CALL YAZDIR
	RETURN

AZALT
	BANKSEL SICAKLIK_REF
	MOVLW H'02'
	SUBWF SICAKLIK_REF,F
	CALL GECIKME
	CALL YAZDIR
	RETURN

;DONUSTUR_KONTROL
;	BTFSC ADCON0,GO
;	GOTO DONUSTUR_KONTROL
;	GOTO YAZDIR

YAZDIR
;	BANKSEL ADRESH
;	MOVF ADRESH,W
;	BANKSEL PORTC
;	MOVWF PORTC
;
;	BANKSEL ADRESL
;	MOVF ADRESL,W
;	BANKSEL PORTB
;	MOVWF PORTB

	MOVF ADRESL,W
	SUBWF SICAKLIK_REF,W
	BTFSS STATUS,Z
	GOTO LED_SONDUR
	GOTO LED_YAK

LED_YAK
	BANKSEL PORTC
	BSF PORTC,0
;	CALL GECIKME
	RETURN

LED_SONDUR
	BANKSEL PORTC
	BCF PORTC,0
;	CALL GECIKME
	RETURN

GECIKME
	MOVLW 0XFF
	MOVWF SAYICI1

TEKRAR1	
	MOVLW 0XFF
	MOVWF SAYICI2

TEKRAR2
	DECFSZ SAYICI2,F
	GOTO TEKRAR2
	DECFSZ SAYICI1,F
	GOTO TEKRAR1
	RETURN

END